## prj.conf
```kconfig
CONFIG_GRAPHIC_UI_MENU=y
CONFIG_LVGL_ENABLE=y
CONFIG_LVGL_9_3=y
```

## src/app_main.c
```c
#include "lv_port.h"
#include "ui.h"

void app_example(void) {
    lv_port_run_demo(ui_init, 0);
}
```

## src/ui.h
```c
// This file was generated by SquareLine Studio
// SquareLine Studio version: SquareLine Studio 1.5.4
// LVGL version: 9.2.2
// Project name: Coffee_machine

#ifndef _COFFEE_MACHINE_UI_H
#define _COFFEE_MACHINE_UI_H

#ifdef __cplusplus
extern "C" {
#endif

#include "lvgl.h"

#include "ui_helpers.h"
#include "components/ui_comp.h"
#include "components/ui_comp_hook.h"
#include "ui_events.h"
#include "ui_theme_manager.h"
#include "ui_themes.h"

///////////////////// SCREENS ////////////////////
#include "screens/ui_Screen_Splash_screen.h"
#include "screens/ui_Screen_Home.h"
#include "screens/ui_Screen_Home_ristretto.h"
#include "screens/ui_Screen_Home_espresso.h"
#include "screens/ui_Screen_Customize.h"
#include "screens/ui_Screen_Customize2.h"
#include "screens/ui_Screen_Brewing.h"
#include "screens/ui_Screen_Brewing_Done.h"
#include "screens/ui_Screen_Settings.h"
#include "screens/ui_Screen_Add_water.h"
#include "screens/ui_Screen_Add_coffee.h"
#include "screens/ui_Screen_Ready.h"

///////////////////// VARIABLES ////////////////////
extern lv_anim_t * left_in_Animation(lv_obj_t * TargetObject, int delay);
extern lv_anim_t * left_out_Animation(lv_obj_t * TargetObject, int delay);
extern lv_anim_t * coffeeleft_Animation(lv_obj_t * TargetObject, int delay);
extern lv_anim_t * progress_Animation(lv_obj_t * TargetObject, int delay);
extern lv_anim_t * with_Animation(lv_obj_t * TargetObject, int delay);
extern lv_anim_t * top_on_slider_Animation(lv_obj_t * TargetObject, int delay);
extern lv_anim_t * icons_bottom_on_Animation(lv_obj_t * TargetObject, int delay);
extern lv_anim_t * right_in_Animation(lv_obj_t * TargetObject, int delay);
extern lv_anim_t * top_off_slider_Animation(lv_obj_t * TargetObject, int delay);
extern lv_anim_t * top_on_alert_Animation(lv_obj_t * TargetObject, int delay);
extern lv_anim_t * enjoy_bottom_on_Animation(lv_obj_t * TargetObject, int delay);
extern lv_anim_t * enjoybtn_top_on_Animation(lv_obj_t * TargetObject, int delay);
extern lv_anim_t * enjoybtn_top_off_Animation(lv_obj_t * TargetObject, int delay);
extern lv_anim_t * enjoy_bottom_off_Animation(lv_obj_t * TargetObject, int delay);
extern lv_anim_t * icons_bottom_off_Animation(lv_obj_t * TargetObject, int delay);
extern lv_anim_t * num_bottom_on_Animation(lv_obj_t * TargetObject, int delay);
extern lv_anim_t * num_bottom_off_Animation(lv_obj_t * TargetObject, int delay);
extern lv_anim_t * right_off_Animation(lv_obj_t * TargetObject, int delay);
extern lv_anim_t * top_off_alert_Animation(lv_obj_t * TargetObject, int delay);
extern lv_anim_t * refill_bottom_on_Animation(lv_obj_t * TargetObject, int delay);
extern lv_anim_t * refill_bottom_off_Animation(lv_obj_t * TargetObject, int delay);
extern lv_anim_t * vector_top_on_Animation(lv_obj_t * TargetObject, int delay);
extern lv_anim_t * vector_top_off_Animation(lv_obj_t * TargetObject, int delay);
extern lv_anim_t * min_top_on_Animation(lv_obj_t * TargetObject, int delay);
extern lv_anim_t * min_top_off_Animation(lv_obj_t * TargetObject, int delay);
extern lv_anim_t * home_slider_top_Animation(lv_obj_t * TargetObject, int delay);
extern lv_anim_t * home_slider_bottom_Animation(lv_obj_t * TargetObject, int delay);
extern lv_anim_t * wave_loop_fg_Animation(lv_obj_t * TargetObject, int delay);
extern lv_anim_t * wave_loop_bg_Animation(lv_obj_t * TargetObject, int delay);
extern lv_anim_t * rotate_Animation(lv_obj_t * TargetObject, int delay);
extern lv_anim_t * with_progress_Animation(lv_obj_t * TargetObject, int delay);
extern lv_anim_t * latte_close_Animation(lv_obj_t * TargetObject, int delay);

// EVENTS
extern lv_obj_t * ui_Startevents____initial_actions0;

// IMAGES AND IMAGE SETS
LV_IMG_DECLARE(ui_img_bg_png);    // assets/BG.png
LV_IMG_DECLARE(ui_img_shape1_png);    // assets/shape1.png
LV_IMG_DECLARE(ui_img_play_button_png);    // assets/Play_button.png
LV_IMG_DECLARE(ui_img_big_espresso_png);    // assets/big_espresso.png
LV_IMG_DECLARE(ui_img_big_ristretto_png);    // assets/big_ristretto.png
LV_IMG_DECLARE(ui_img_big_latte_png);    // assets/big_latte.png
LV_IMG_DECLARE(ui_img_arrow_png);    // assets/arrow.png
LV_IMG_DECLARE(ui_img_ble_png);    // assets/ble.png
LV_IMG_DECLARE(ui_img_wifi_png);    // assets/wifi.png
LV_IMG_DECLARE(ui_img_settings_png);    // assets/settings.png
LV_IMG_DECLARE(ui_img_latte_illustration_png);    // assets/latte_illustration.png
LV_IMG_DECLARE(ui_img_chevron_png);    // assets/chevron.png
LV_IMG_DECLARE(ui_img_chevron1_png);    // assets/chevron-1.png
LV_IMG_DECLARE(ui_img_disabledbean_png);    // assets/disabledbean.png
LV_IMG_DECLARE(ui_img_beans_white_png);    // assets/beans_white.png
LV_IMG_DECLARE(ui_img_cup_png);    // assets/cup.png
LV_IMG_DECLARE(ui_img_cups_png);    // assets/cups.png
LV_IMG_DECLARE(ui_img_coffee_illustration_png);    // assets/Coffee_illustration.png
LV_IMG_DECLARE(ui_img_espresso_png);    // assets/espresso.png
LV_IMG_DECLARE(ui_img_slider_bg_png);    // assets/slider_bg.png
LV_IMG_DECLARE(ui_img_top_png);    // assets/Top.png
LV_IMG_DECLARE(ui_img_parameters_png);    // assets/parameters.png
LV_IMG_DECLARE(ui_img_parameters1_png);    // assets/parameters-1.png
LV_IMG_DECLARE(ui_img_temp_body_png);    // assets/temp_body.png
LV_IMG_DECLARE(ui_img_temperature_png);    // assets/temperature.png
LV_IMG_DECLARE(ui_img_foam_body_png);    // assets/foam_body.png
LV_IMG_DECLARE(ui_img_foam_png);    // assets/foam.png
LV_IMG_DECLARE(ui_img_done_png);    // assets/done.png
LV_IMG_DECLARE(ui_img_standby_png);    // assets/standby.png
LV_IMG_DECLARE(ui_img_light_png);    // assets/light.png
LV_IMG_DECLARE(ui_img_water_png);    // assets/water.png
LV_IMG_DECLARE(ui_img_clean_png);    // assets/clean.png
LV_IMG_DECLARE(ui_img_taste1_png);    // assets/taste1.png
LV_IMG_DECLARE(ui_img_cup1_png);    // assets/cup1.png
LV_IMG_DECLARE(ui_img_units_png);    // assets/units.png
LV_IMG_DECLARE(ui_img_languages_png);    // assets/languages.png
LV_IMG_DECLARE(ui_img_profile_png);    // assets/profile.png
LV_IMG_DECLARE(ui_img_roller_png);    // assets/roller.png
LV_IMG_DECLARE(ui_img_alert_png);    // assets/alert.png
LV_IMG_DECLARE(ui_img_tank_png);    // assets/tank.png
LV_IMG_DECLARE(ui_img_wave1_png);    // assets/wave1.png
LV_IMG_DECLARE(ui_img_wave_bottom_png);    // assets/wave_bottom.png
LV_IMG_DECLARE(ui_img_done_60_png);    // assets/done_60.png
LV_IMG_DECLARE(ui_img_arrows_png);    // assets/arrows.png
LV_IMG_DECLARE(ui_img_bigbean_png);    // assets/bigbean.png

// FONTS
LV_FONT_DECLARE(ui_font_H1_bold);
LV_FONT_DECLARE(ui_font_H2_bold);
LV_FONT_DECLARE(ui_font_H2_bold);
LV_FONT_DECLARE(ui_font_H3_bold);
LV_FONT_DECLARE(ui_font_Min);
LV_FONT_DECLARE(ui_font_P1_bold);
LV_FONT_DECLARE(ui_font_P1_medium);
LV_FONT_DECLARE(ui_font_P2_medium);
LV_FONT_DECLARE(ui_font_badge2);
LV_FONT_DECLARE(ui_font_exclamation);
LV_FONT_DECLARE(ui_font_icon);

// UI INIT
void ui_init(void);
void ui_destroy(void);

#ifdef __cplusplus
} /*extern "C"*/
#endif

#endif
```

## src/ui_events.h
```c
// This file was generated by SquareLine Studio
// SquareLine Studio version: SquareLine Studio 1.5.4
// LVGL version: 9.2.2
// Project name: Coffee_machine

#ifndef _UI_EVENTS_H
#define _UI_EVENTS_H

#ifdef __cplusplus
extern "C" {
#endif

#ifdef __cplusplus
} /*extern "C"*/
#endif

#endif
```

## src/ui_helpers.c
```c
// This file was generated by SquareLine Studio
// SquareLine Studio version: SquareLine Studio 1.5.4
// LVGL version: 9.2.2
// Project name: Coffee_machine

#include "ui_helpers.h"

void _ui_bar_set_property(lv_obj_t * target, int id, int val)
{
    if(id == _UI_BAR_PROPERTY_VALUE_WITH_ANIM) lv_bar_set_value(target, val, LV_ANIM_ON);
    if(id == _UI_BAR_PROPERTY_VALUE) lv_bar_set_value(target, val, LV_ANIM_OFF);
}

void _ui_basic_set_property(lv_obj_t * target, int id, int val)
{
    if(id == _UI_BASIC_PROPERTY_POSITION_X) lv_obj_set_x(target, val);
    if(id == _UI_BASIC_PROPERTY_POSITION_Y) lv_obj_set_y(target, val);
    if(id == _UI_BASIC_PROPERTY_WIDTH) lv_obj_set_width(target, val);
    if(id == _UI_BASIC_PROPERTY_HEIGHT) lv_obj_set_height(target, val);
}

void _ui_dropdown_set_property(lv_obj_t * target, int id, int val)
{
    if(id == _UI_DROPDOWN_PROPERTY_SELECTED) lv_dropdown_set_selected(target, val);
}

void _ui_image_set_property(lv_obj_t * target, int id, uint8_t * val)
{
    if(id == _UI_IMAGE_PROPERTY_IMAGE) lv_image_set_src(target, val);
}

void _ui_label_set_property(lv_obj_t * target, int id, const char * val)
{
    if(id == _UI_LABEL_PROPERTY_TEXT) lv_label_set_text(target, val);
}

void _ui_roller_set_property(lv_obj_t * target, int id, int val)
{
    if(id == _UI_ROLLER_PROPERTY_SELECTED_WITH_ANIM) lv_roller_set_selected(target, val, LV_ANIM_ON);
    if(id == _UI_ROLLER_PROPERTY_SELECTED) lv_roller_set_selected(target, val, LV_ANIM_OFF);
}

void _ui_slider_set_property(lv_obj_t * target, int id, int val)
{
    if(id == _UI_SLIDER_PROPERTY_VALUE_WITH_ANIM) lv_slider_set_value(target, val, LV_ANIM_ON);
    if(id == _UI_SLIDER_PROPERTY_VALUE) lv_slider_set_value(target, val, LV_ANIM_OFF);
}

void _ui_screen_change(lv_obj_t ** target, lv_screen_load_anim_t fademode, int spd, int delay,
                       void (*target_init)(void))
{
    if(*target == NULL)
        target_init();
    lv_screen_load_anim(*target, fademode, spd, delay, false);
}

void _ui_arc_increment(lv_obj_t * target, int val)
{
    int old = lv_arc_get_value(target);
    lv_arc_set_value(target, old + val);
    lv_obj_send_event(target, LV_EVENT_VALUE_CHANGED, 0);
}

void _ui_bar_increment(lv_obj_t * target, int val, int anm)
{
    int old = lv_bar_get_value(target);
    lv_bar_set_value(target, old + val, anm);
}

void _ui_slider_increment(lv_obj_t * target, int val, int anm)
{
    int old = lv_slider_get_value(target);
    lv_slider_set_value(target, old + val, anm);
    lv_obj_send_event(target, LV_EVENT_VALUE_CHANGED, 0);
}

void _ui_keyboard_set_target(lv_obj_t * keyboard, lv_obj_t * textarea)
{
    lv_keyboard_set_textarea(keyboard, textarea);
}

void _ui_flag_modify(lv_obj_t * target, int32_t flag, int value)
{
    if(value == _UI_MODIFY_FLAG_TOGGLE) {
        if(lv_obj_has_flag(target, flag)) lv_obj_remove_flag(target, flag);
        else lv_obj_add_flag(target, flag);
    }
    else if(value == _UI_MODIFY_FLAG_ADD) lv_obj_add_flag(target, flag);
    else lv_obj_remove_flag(target, flag);
}
void _ui_state_modify(lv_obj_t * target, int32_t state, int value)
{
    if(value == _UI_MODIFY_STATE_TOGGLE) {
        if(lv_obj_has_state(target, state)) lv_obj_remove_state(target, state);
        else lv_obj_add_state(target, state);
    }
    else if(value == _UI_MODIFY_STATE_ADD) lv_obj_add_state(target, state);
    else lv_obj_remove_state(target, state);
}

void _ui_textarea_move_cursor(lv_obj_t * target, int val)
{
    if(val == UI_MOVE_CURSOR_UP) lv_textarea_cursor_up(target);
    if(val == UI_MOVE_CURSOR_RIGHT) lv_textarea_cursor_right(target);
    if(val == UI_MOVE_CURSOR_DOWN) lv_textarea_cursor_down(target);
    if(val == UI_MOVE_CURSOR_LEFT) lv_textarea_cursor_left(target);
    lv_obj_add_state(target, LV_STATE_FOCUSED);
}

typedef void (*screen_destroy_cb_t)(void);
void scr_unloaded_delete_cb(lv_event_t * e)
{
    // Get the destroy callback from user_data
    screen_destroy_cb_t destroy_cb = lv_event_get_user_data(e);
    if(destroy_cb) {
        destroy_cb();  // call the specific screen destroy function
    }
}
void _ui_opacity_set(lv_obj_t * target, int val)
{
    lv_obj_set_style_opa(target, val, 0);
}

void _ui_anim_callback_free_user_data(lv_anim_t * a)
{
    lv_free(a->user_data);
    a->user_data = NULL;
}

void _ui_anim_callback_set_x(lv_anim_t * a, int32_t v)
{
    ui_anim_user_data_t * usr = (ui_anim_user_data_t *)a->user_data;
    lv_obj_set_x(usr->target, v);
}

void _ui_anim_callback_set_y(lv_anim_t * a, int32_t v)
{
    ui_anim_user_data_t * usr = (ui_anim_user_data_t *)a->user_data;
    lv_obj_set_y(usr->target, v);
}

void _ui_anim_callback_set_width(lv_anim_t * a, int32_t v)
{
    ui_anim_user_data_t * usr = (ui_anim_user_data_t *)a->user_data;
    lv_obj_set_width(usr->target, v);
}

void _ui_anim_callback_set_height(lv_anim_t * a, int32_t v)
{
    ui_anim_user_data_t * usr = (ui_anim_user_data_t *)a->user_data;
    lv_obj_set_height(usr->target, v);
}

void _ui_anim_callback_set_opacity(lv_anim_t * a, int32_t v)
{
    ui_anim_user_data_t * usr = (ui_anim_user_data_t *)a->user_data;
    lv_obj_set_style_opa(usr->target, v, 0);
}

void _ui_anim_callback_set_image_zoom(lv_anim_t * a, int32_t v)
{
    ui_anim_user_data_t * usr = (ui_anim_user_data_t *)a->user_data;
    lv_image_set_scale(usr->target, v);
}

void _ui_anim_callback_set_image_angle(lv_anim_t * a, int32_t v)
{
    ui_anim_user_data_t * usr = (ui_anim_user_data_t *)a->user_data;
    lv_image_set_rotation(usr->target, v);
}

void _ui_anim_callback_set_image_frame(lv_anim_t * a, int32_t v)
{
    ui_anim_user_data_t * usr = (ui_anim_user_data_t *)a->user_data;
    usr->val = v;
    if(v < 0) v = 0;
    if(v >= usr->imgset_size) v = usr->imgset_size - 1;
    lv_image_set_src(usr->target, usr->imgset[v]);
}

int32_t _ui_anim_callback_get_x(lv_anim_t * a)
{
    ui_anim_user_data_t * usr = (ui_anim_user_data_t *)a->user_data;
    return lv_obj_get_x_aligned(usr->target);
}

int32_t _ui_anim_callback_get_y(lv_anim_t * a)
{
    ui_anim_user_data_t * usr = (ui_anim_user_data_t *)a->user_data;
    return lv_obj_get_y_aligned(usr->target);
}

int32_t _ui_anim_callback_get_width(lv_anim_t * a)
{
    ui_anim_user_data_t * usr = (ui_anim_user_data_t *)a->user_data;
    return lv_obj_get_width(usr->target);
}

int32_t _ui_anim_callback_get_height(lv_anim_t * a)
{
    ui_anim_user_data_t * usr = (ui_anim_user_data_t *)a->user_data;
    return lv_obj_get_height(usr->target);
}

int32_t _ui_anim_callback_get_opacity(lv_anim_t * a)
{
    ui_anim_user_data_t * usr = (ui_anim_user_data_t *)a->user_data;
    return lv_obj_get_style_opa(usr->target, 0);
}

int32_t _ui_anim_callback_get_image_zoom(lv_anim_t * a)
{
    ui_anim_user_data_t * usr = (ui_anim_user_data_t *)a->user_data;
    return lv_image_get_scale(usr->target);
}

int32_t _ui_anim_callback_get_image_angle(lv_anim_t * a)
{
    ui_anim_user_data_t * usr = (ui_anim_user_data_t *)a->user_data;
    return lv_image_get_rotation(usr->target);
}

int32_t _ui_anim_callback_get_image_frame(lv_anim_t * a)
{
    ui_anim_user_data_t * usr = (ui_anim_user_data_t *)a->user_data;
    return usr->val;
}

void _ui_arc_set_text_value(lv_obj_t * trg, lv_obj_t * src, const char * prefix, const char * postfix)
{
    char buf[_UI_TEMPORARY_STRING_BUFFER_SIZE];
    lv_snprintf(buf, sizeof(buf), "%s%d%s", prefix, (int)lv_arc_get_value(src), postfix);
    lv_label_set_text(trg, buf);
}

void _ui_slider_set_text_value(lv_obj_t * trg, lv_obj_t * src, const char * prefix, const char * postfix)
{
    char buf[_UI_TEMPORARY_STRING_BUFFER_SIZE];
    lv_snprintf(buf, sizeof(buf), "%s%d%s", prefix, (int)lv_slider_get_value(src), postfix);
    lv_label_set_text(trg, buf);
}
void _ui_checked_set_text_value(lv_obj_t * trg, lv_obj_t * src, const char * txt_on, const char * txt_off)
{
    if(lv_obj_has_state(src, LV_STATE_CHECKED)) lv_label_set_text(trg, txt_on);
    else lv_label_set_text(trg, txt_off);
}

void _ui_spinbox_step(lv_obj_t * target, int val)
{
    if(val > 0) lv_spinbox_increment(target);
    else lv_spinbox_decrement(target);

    lv_obj_send_event(target, LV_EVENT_VALUE_CHANGED, 0);
}

void _ui_switch_theme(int val)
{
#ifdef UI_THEME_ACTIVE
    ui_theme_set(val);
#endif
}
```

## src/ui_helpers.h
```c
// This file was generated by SquareLine Studio
// SquareLine Studio version: SquareLine Studio 1.5.4
// LVGL version: 9.2.2
// Project name: Coffee_machine

#ifndef _COFFEE_MACHINE_UI_HELPERS_H
#define _COFFEE_MACHINE_UI_HELPERS_H

#ifdef __cplusplus
extern "C" {
#endif

#include "ui.h"

#define _UI_TEMPORARY_STRING_BUFFER_SIZE 32
#define _UI_BAR_PROPERTY_VALUE 0
#define _UI_BAR_PROPERTY_VALUE_WITH_ANIM 1
void _ui_bar_set_property(lv_obj_t * target, int id, int val);

#define _UI_BASIC_PROPERTY_POSITION_X 0
#define _UI_BASIC_PROPERTY_POSITION_Y 1
#define _UI_BASIC_PROPERTY_WIDTH 2
#define _UI_BASIC_PROPERTY_HEIGHT 3
void _ui_basic_set_property(lv_obj_t * target, int id, int val);

#define _UI_DROPDOWN_PROPERTY_SELECTED 0
void _ui_dropdown_set_property(lv_obj_t * target, int id, int val);

#define _UI_IMAGE_PROPERTY_IMAGE 0
void _ui_image_set_property(lv_obj_t * target, int id, uint8_t * val);

#define _UI_LABEL_PROPERTY_TEXT 0
void _ui_label_set_property(lv_obj_t * target, int id, const char * val);

#define _UI_ROLLER_PROPERTY_SELECTED 0
#define _UI_ROLLER_PROPERTY_SELECTED_WITH_ANIM 1
void _ui_roller_set_property(lv_obj_t * target, int id, int val);

#define _UI_SLIDER_PROPERTY_VALUE 0
#define _UI_SLIDER_PROPERTY_VALUE_WITH_ANIM 1
void _ui_slider_set_property(lv_obj_t * target, int id, int val);

void _ui_screen_change(lv_obj_t ** target, lv_screen_load_anim_t fademode, int spd, int delay,
                       void (*target_init)(void));

void _ui_arc_increment(lv_obj_t * target, int val);

void _ui_bar_increment(lv_obj_t * target, int val, int anm);

void _ui_slider_increment(lv_obj_t * target, int val, int anm);

void _ui_keyboard_set_target(lv_obj_t * keyboard, lv_obj_t * textarea);

#define _UI_MODIFY_FLAG_ADD 0
#define _UI_MODIFY_FLAG_REMOVE 1
#define _UI_MODIFY_FLAG_TOGGLE 2
void _ui_flag_modify(lv_obj_t * target, int32_t flag, int value);

#define _UI_MODIFY_STATE_ADD 0
#define _UI_MODIFY_STATE_REMOVE 1
#define _UI_MODIFY_STATE_TOGGLE 2
void _ui_state_modify(lv_obj_t * target, int32_t state, int value);

#define UI_MOVE_CURSOR_UP 0
#define UI_MOVE_CURSOR_RIGHT 1
#define UI_MOVE_CURSOR_DOWN 2
#define UI_MOVE_CURSOR_LEFT 3
void _ui_textarea_move_cursor(lv_obj_t * target, int val)
;

void scr_unloaded_delete_cb(lv_event_t * e);

void _ui_opacity_set(lv_obj_t * target, int val);

/** Describes an animation*/
typedef struct _ui_anim_user_data_t {
    lv_obj_t * target;
    lv_image_dsc_t ** imgset;
    int32_t imgset_size;
    int32_t val;
} ui_anim_user_data_t;
void _ui_anim_callback_free_user_data(lv_anim_t * a);

void _ui_anim_callback_set_x(lv_anim_t * a, int32_t v);

void _ui_anim_callback_set_y(lv_anim_t * a, int32_t v);

void _ui_anim_callback_set_width(lv_anim_t * a, int32_t v);

void _ui_anim_callback_set_height(lv_anim_t * a, int32_t v);

void _ui_anim_callback_set_opacity(lv_anim_t * a, int32_t v);

void _ui_anim_callback_set_image_zoom(lv_anim_t * a, int32_t v);

void _ui_anim_callback_set_image_angle(lv_anim_t * a, int32_t v);

void _ui_anim_callback_set_image_frame(lv_anim_t * a, int32_t v);

int32_t _ui_anim_callback_get_x(lv_anim_t * a);

int32_t _ui_anim_callback_get_y(lv_anim_t * a);

int32_t _ui_anim_callback_get_width(lv_anim_t * a);

int32_t _ui_anim_callback_get_height(lv_anim_t * a);

int32_t _ui_anim_callback_get_opacity(lv_anim_t * a);

int32_t _ui_anim_callback_get_image_zoom(lv_anim_t * a);

int32_t _ui_anim_callback_get_image_angle(lv_anim_t * a);

int32_t _ui_anim_callback_get_image_frame(lv_anim_t * a);

void _ui_arc_set_text_value(lv_obj_t * trg, lv_obj_t * src, const char * prefix, const char * postfix);

void _ui_slider_set_text_value(lv_obj_t * trg, lv_obj_t * src, const char * prefix, const char * postfix);

void _ui_checked_set_text_value(lv_obj_t * trg, lv_obj_t * src, const char * txt_on, const char * txt_off);

void _ui_spinbox_step(lv_obj_t * target, int val)
;

void _ui_switch_theme(int val)
;

#ifdef __cplusplus
} /*extern "C"*/
#endif

#endif
```

## src/ui_themes.c
```c
// This file was generated by SquareLine Studio
// SquareLine Studio version: SquareLine Studio 1.5.4
// LVGL version: 9.2.2
// Project name: Coffee_machine

#include "ui.h"

const ui_theme_variable_t _ui_theme_color_fg_Primary[1] = {0xFFFFFF};
const ui_theme_variable_t _ui_theme_alpha_fg_Primary[1] = {255};

const ui_theme_variable_t _ui_theme_color_fg_Secondary[1] = {0x353B40};
const ui_theme_variable_t _ui_theme_alpha_fg_Secondary[1] = {255};

const ui_theme_variable_t _ui_theme_color_fg_Disabled[1] = {0x8E989F};
const ui_theme_variable_t _ui_theme_alpha_fg_Disabled[1] = {255};

const ui_theme_variable_t _ui_theme_color_bg_Secondary[1] = {0x303030};
const ui_theme_variable_t _ui_theme_alpha_bg_Secondary[1] = {255};

const ui_theme_variable_t _ui_theme_color_bg_Tertiary[1] = {0x000000};
const ui_theme_variable_t _ui_theme_alpha_bg_Tertiary[1] = {255};

const ui_theme_variable_t _ui_theme_color_overlay_Primary[1] = {0x304149};
const ui_theme_variable_t _ui_theme_alpha_overlay_Primary[1] = {64};

const ui_theme_variable_t _ui_theme_color_border_Primary[1] = {0x6D777E};
const ui_theme_variable_t _ui_theme_alpha_border_Primary[1] = {255};

const ui_theme_variable_t _ui_theme_color_border_Secondary[1] = {0x353B40};
const ui_theme_variable_t _ui_theme_alpha_border_Secondary[1] = {255};

const ui_theme_variable_t _ui_theme_color_Red[1] = {0xE63946};
const ui_theme_variable_t _ui_theme_alpha_Red[1] = {255};

const ui_theme_variable_t _ui_theme_color_Orange[1] = {0xF4A261};
const ui_theme_variable_t _ui_theme_alpha_Orange[1] = {255};

const ui_theme_variable_t _ui_theme_color_Yellow[1] = {0xF9C74F};
const ui_theme_variable_t _ui_theme_alpha_Yellow[1] = {255};

const ui_theme_variable_t _ui_theme_color_Green[1] = {0x39D254};
const ui_theme_variable_t _ui_theme_alpha_Green[1] = {255};
uint8_t ui_theme_idx = UI_THEME_DEFAULT;

void ui_theme_set(uint8_t theme_idx)
{
    ui_theme_idx = theme_idx;
    _ui_theme_set_variable_styles(UI_VARIABLE_STYLES_MODE_FOLLOW);
}
```

## src/ui_themes.h
```c
// This file was generated by SquareLine Studio
// SquareLine Studio version: SquareLine Studio 1.5.4
// LVGL version: 9.2.2
// Project name: Coffee_machine

#ifndef _UI_THEMES_H
#define _UI_THEMES_H

#ifdef __cplusplus
extern "C" {
#endif

#define UI_THEME_COLOR_FG_PRIMARY 0
#define UI_THEME_COLOR_FG_SECONDARY 1
#define UI_THEME_COLOR_FG_DISABLED 2
#define UI_THEME_COLOR_BG_SECONDARY 3
#define UI_THEME_COLOR_BG_TERTIARY 4
#define UI_THEME_COLOR_OVERLAY_PRIMARY 5
#define UI_THEME_COLOR_BORDER_PRIMARY 6
#define UI_THEME_COLOR_BORDER_SECONDARY 7
#define UI_THEME_COLOR_RED 8
#define UI_THEME_COLOR_ORANGE 9
#define UI_THEME_COLOR_YELLOW 10
#define UI_THEME_COLOR_GREEN 11

#define UI_THEME_DEFAULT 0

extern const ui_theme_variable_t _ui_theme_color_fg_Primary[1];
extern const ui_theme_variable_t _ui_theme_alpha_fg_Primary[1];

extern const ui_theme_variable_t _ui_theme_color_fg_Secondary[1];
extern const ui_theme_variable_t _ui_theme_alpha_fg_Secondary[1];

extern const ui_theme_variable_t _ui_theme_color_fg_Disabled[1];
extern const ui_theme_variable_t _ui_theme_alpha_fg_Disabled[1];

extern const ui_theme_variable_t _ui_theme_color_bg_Secondary[1];
extern const ui_theme_variable_t _ui_theme_alpha_bg_Secondary[1];

extern const ui_theme_variable_t _ui_theme_color_bg_Tertiary[1];
extern const ui_theme_variable_t _ui_theme_alpha_bg_Tertiary[1];

extern const ui_theme_variable_t _ui_theme_color_overlay_Primary[1];
extern const ui_theme_variable_t _ui_theme_alpha_overlay_Primary[1];

extern const ui_theme_variable_t _ui_theme_color_border_Primary[1];
extern const ui_theme_variable_t _ui_theme_alpha_border_Primary[1];

extern const ui_theme_variable_t _ui_theme_color_border_Secondary[1];
extern const ui_theme_variable_t _ui_theme_alpha_border_Secondary[1];

extern const ui_theme_variable_t _ui_theme_color_Red[1];
extern const ui_theme_variable_t _ui_theme_alpha_Red[1];

extern const ui_theme_variable_t _ui_theme_color_Orange[1];
extern const ui_theme_variable_t _ui_theme_alpha_Orange[1];

extern const ui_theme_variable_t _ui_theme_color_Yellow[1];
extern const ui_theme_variable_t _ui_theme_alpha_Yellow[1];

extern const ui_theme_variable_t _ui_theme_color_Green[1];
extern const ui_theme_variable_t _ui_theme_alpha_Green[1];

extern const uint32_t * ui_theme_colors[1];
extern const uint8_t * ui_theme_alphas[1];
extern uint8_t ui_theme_idx;

void ui_theme_set(uint8_t theme_idx);

#ifdef __cplusplus
} /*extern "C"*/
#endif

#endif
```
